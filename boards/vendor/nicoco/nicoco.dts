/*
 * Copyright (c) 2022-2023 Marcin Niestroj
 *
 * SPDX-License-Identifier: Apache-2.0
 */

/dts-v1/;
#include "nicoco_common.dtsi"

/ {
	model = "Seeed XIAO BLE based LSM6DSV16X evaluation";
	compatible = "vendor,nicoco";
};

## boards/nicoco/Kconfig.defconfig
```kconfig
if BOARD_NICOCO

config BT_CTLR
	default BT

if USB_DEVICE_STACK

config UART_CONSOLE
	default CONSOLE

config USB_DEVICE_INITIALIZE_AT_BOOT
	default y

endif # USB_DEVICE_STACK

endif # BOARD_NICOCO
```

## boards/nicoco/board.yml
```yaml
board:
  name: nicoco
  revision:
    format: major.minor.patch
    default: 0.2.0
    exact: true
    revisions:
    - name: 0.1.0
    - name: 0.2.0
  socs:
  - name: nrf52840
    variants:
    - name: 'sense'
```

## dts/bindings/sensor/zephyr,lsm6dsv16bx-i2c.yaml
```yaml
description: |
    STMicroelectronics LSM6DSV16BX 6-axis IMU (Inertial Measurement Unit) sensor
    accessed through I2C bus

compatible: "zephyr,lsm6dsv16bx"

include: ["i2c-device.yaml"]
```

## dts/bindings/sensor/zephyr,lsm6dsv16bx-spi.yaml
```yaml
description: |
    STMicroelectronics LSM6DSV16BX 6-axis IMU (Inertial Measurement Unit) sensor
    accessed through SPI bus

compatible: "zephyr,lsm6dsv16bx"

include: ["spi-device.yaml"]
```

## dts/bindings/sensor/zephyr,lsm6dsv16x-i2c.yaml
```yaml
description: |
    STMicroelectronics LSM6DSV16X 6-axis IMU (Inertial Measurement Unit) sensor
    accessed through I2C bus

compatible: "zephyr,lsm6dsv16x"

include: ["i2c-device.yaml"]
```

## dts/bindings/sensor/zephyr,lsm6dsv16x-spi.yaml
```yaml
description: |
    STMicroelectronics LSM6DSV16X 6-axis IMU (Inertial Measurement Unit) sensor
    accessed through SPI bus

compatible: "zephyr,lsm6dsv16x"

include: ["spi-device.yaml"]
```

## lib/fit_sdk/Kconfig
```kconfig
config FIT_SDK
	bool "Support for the FIT file library"
	help
	  This option enables the FIT file library.

module = FIT_SDK
module-str = FIT_SDK
source "subsys/logging/Kconfig.template.log_config"
```

## lib/gopro_bluetooth/Kconfig
```kconfig
# Copyright (c) 2021, Legrand North America, LLC.
# SPDX-License-Identifier: Apache-2.0

config XIAO_GOPRO_BLUETOOTH
	bool "Support for Xiao BLE GoPro Bluetooth library"
	help
	  This option enables the Bluetooth Central library used to interact with a GoPro.

module = XIAO_GOPRO_BLUETOOTH
module-str = XIAO_GOPRO_BLUETOOTH
source "subsys/logging/Kconfig.template.log_config"
```

## lib/lsm6dsv16bx/Kconfig.template.fsm_alg
```kconfig
# Template for FSM algorithm configurations
config LSM6DSV16BX_FSM_USE_ALG_$(alg-number)
    bool "Use algorithm n°$(alg-number)"
    help
      This option enables the use of FSM algorithm n°$(alg-number)

if LSM6DSV16BX_FSM_USE_ALG_$(alg-number)

config LSM6DSV16BX_FSM_ALG_$(alg-number)_CONFIG_FILE_PATH
	string "Path to the FSM configuration"
	help
	  This option allows to specify the path to the configuration file generated by Unico-GUI for FSM algorithm n°$(alg-number). This path should be relative to a CMake include path.

config LSM6DSV16BX_FSM_ALG_$(alg-number)_NAME
    string "Name of the FSM algorithm n°$(alg-number)"
    default "FSM Alorithm $(alg-number)"
    help
      This option allows to specify the human-readable name of algorithm n°$(alg-number)

endif
```

## lib/lsm6dsv16x/Kconfig
```kconfig
config LSM6DSV16X
	bool "Support for LSM6DSV16X sensor library"
	select LSM6DSV16X_I2C if $(dt_compat_on_bus,$(DT_COMPAT_ZEPHYR_LSM6DSV16X),i2c)
	select LSM6DSV16X_SPI if $(dt_compat_on_bus,$(DT_COMPAT_ZEPHYR_LSM6DSV16X),spi)
	help
	  This option enables the LSM6DSV16X library.

config LSM6DSV16X_SPI
	bool
	select SPI
	help
	  This options enables the SPI communication with LSM6DSV16X sensor.

config LSM6DSV16X_I2C
	bool
	select I2C
	help
	  This options enables the I2C communication with LSM6DSV16X sensor.

config LSM6DSV16X_CALIBRATION_SETTLING_TIME
	int "Calibration settling time in seconds"
	default 5
	help
	  In order to measure gyroscope bias, it is best to let the sensor rest to let the values settle on startup.
	  This option configures the time in seconds between the start of the sensor, and the first gyroscope bias measurement.

config LSM6DSV16X_CALIBRATION_TIMEOUT
	int "Calibration timeout in seconds"
	default 30
	help
	  This option configures the time in seconds after which the calibration is considered failed if we haven't received any data.

if LSM6DSV16X

config GPIO
	default y

config LSM6DSV16X_SAMPLES_TO_DISCARD
	int "Nb of samples to discard at the start of a session"
	default 5

# Define 8 possible FSM algorithms using the template.
alg-number = 1
rsource "Kconfig.template.fsm_alg"

alg-number = 2
rsource "Kconfig.template.fsm_alg"

alg-number = 3
rsource "Kconfig.template.fsm_alg"

alg-number = 4
rsource "Kconfig.template.fsm_alg"

alg-number = 5
rsource "Kconfig.template.fsm_alg"

alg-number = 6
rsource "Kconfig.template.fsm_alg"

alg-number = 7
rsource "Kconfig.template.fsm_alg"

alg-number = 8
rsource "Kconfig.template.fsm_alg"

endif # LSM6DSV16X

module = LSM6DSV16X
module-str = LSM6DSV16X
source "subsys/logging/Kconfig.template.log_config"
```

## lib/smp_bluetooth/Kconfig
```kconfig
# Copyright (c) 2021, Legrand North America, LLC.
# SPDX-License-Identifier: Apache-2.0

config XIAO_SMP_BLUETOOTH
	bool "Support for Xiao BLE Bluetooth library"
	help
	  This option enables the 'custom' library

module = XIAO_SMP_BLUETOOTH
module-str = XIAO_SMP_BLUETOOTH
source "subsys/logging/Kconfig.template.log_config"
```

## lib/xiao_ble_shell/Kconfig
```kconfig
# Copyright (c) 2021, Legrand North America, LLC.
# SPDX-License-Identifier: Apache-2.0

config XIAO_BLE_SHELL
	bool "Support for Xiao BLE Shell library"
	help
	  This option enables the Xiao BLE Shell library

if XIAO_BLE_SHELL

config PRINTK
	default y

config SHELL
	default y

config SHELL_STACK_SIZE
	default 1024

config SHELL_BACKEND_SERIAL
	default y

config THREAD_MONITOR
	default y

config INIT_STACKS
	default y

config THREAD_NAME
	default y

config THREAD_MONITOR
	default y

config THREAD_STACK_INFO
	default y

config KERNEL_SHELL
	default y

config DATE_TIME
	default y

config DATE_TIME_MODEM
	default n

config DATE_TIME_NTP
	default n

endif # XIAO_BLE_SHELL
```

## lib/xiao_ble_usb_mass_storage/Kconfig
```kconfig
# Copyright (c) 2021, Legrand North America, LLC.
# SPDX-License-Identifier: Apache-2.0

module = XIAO_BLE_USB_MASS_STORAGE
module-str = XIAO_BLE_USB_MASS_STORAGE
source "subsys/logging/Kconfig.template.log_config"

config XIAO_BLE_USB_MASS_STORAGE
	bool "Support for Xiao BLE USB Mass Storage library"
	help
	  This option enables the Xiao BLE USB Mass Storage library

if XIAO_BLE_USB_MASS_STORAGE

config USB_DEVICE_STACK
	default y

config USB_DEVICE_PRODUCT
	default "Xiao BLE USB Mass Storage"

config USB_DEVICE_PID
	default 0x0008

config USB_MASS_STORAGE
	default y

config USB_DEVICE_INITIALIZE_AT_BOOT
	default n

config DISK_DRIVER_FLASH
	default y

config FILE_SYSTEM
	default y

config FAT_FILESYSTEM_ELM
	default y

config FLASH_MAP
	default y

config FLASH_PAGE_LAYOUT
	default y

config MASS_STORAGE_DISK_NAME
	default "NAND"

config NORDIC_QSPI_NOR
	default y

config NORDIC_QSPI_NOR_FLASH_LAYOUT_PAGE_SIZE
	default 4096

config USB_DRIVER_LOG_LEVEL
	default XIAO_BLE_USB_MASS_STORAGE_LOG_LEVEL

config USB_DEVICE_LOG_LEVEL
	default XIAO_BLE_USB_MASS_STORAGE_LOG_LEVEL

config USB_MASS_STORAGE_LOG_LEVEL
	default XIAO_BLE_USB_MASS_STORAGE_LOG_LEVEL

config FLASH_LOG_LEVEL
	default XIAO_BLE_USB_MASS_STORAGE_LOG_LEVEL

config USB_DRIVER_LOG_LEVEL
	default XIAO_BLE_USB_MASS_STORAGE_LOG_LEVEL

endif # XIAO_BLE_SHELL
```

## tests/lib/custom/testcase.yaml
```yaml
common:
  tags: extensibility
  integration_platforms:
    - nicoco
tests:
  lib.custom: {}
  lib.custom.non_default:
    extra_args: CONFIG_CUSTOM_GET_VALUE_DEFAULT=6
```

## west.yml
```yaml
# Copyright (c) 2021 Nordic Semiconductor ASA
# SPDX-License-Identifier: Apache-2.0

manifest:
  self:
    west-commands: scripts/west-commands.yml

  remotes:
    - name: ncs
      url-base: https://github.com/nrfconnect
    - name: st-remote
      url-base: https://github.com/STMicroelectronics
    - name: personal-repo
      url-base: https://github.com/nicogou/

  projects:
    - name: nrf
      remote: ncs
      repo-path: sdk-nrf
      revision: main
      import: true
    - name: lsm6dsv16x-pid
      remote: st-remote
      revision: main
      path: xiao-ble-lsm6dsv16x.git/lib/lsm6dsv16x/lsm6dsv16x-pid
    - name: lsm6dsv16bx-pid
      remote: st-remote
      revision: main
      path: xiao-ble-lsm6dsv16x.git/lib/lsm6dsv16bx/lsm6dsv16bx-pid
    - name: FIT-SDK
      remote: personal-repo
      revision: main
      path: xiao-ble-lsm6dsv16x.git/lib/fit_sdk/custom_fit_sdk
```
